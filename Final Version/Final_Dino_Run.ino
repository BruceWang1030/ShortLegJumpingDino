
#include <Elegoo_GFX.h>    // Core graphics library
#include <Elegoo_TFTLCD.h> // Hardware-specific library
#include <TouchScreen.h>
#include <stdint.h>
#if defined(__SAM3X8E__)
#undef __FlashStringHelper::F(string_literal)
#define F(string_literal) string_literal
#endif
//Pins
#define LCD_CS A3 // Chip Select - Analog 3
#define LCD_CD A2 // Command/Data - Analog 2
#define LCD_WR A1 // LCD Write - Analog 1
#define LCD_RD A0 // LCD Read - Analog 0
#define YP A3  //Analog
#define XM A2  //Analog
#define YM 9   //digital pin
#define XP 8   //digital pin
#define LCD_RESET A4 //Reset pin
//   D0 connects to digital pin 8  
//   D1 connects to digital pin 9   
//   D2 connects to digital pin 2
//   D3 connects to digital pin 3
//   D4 connects to digital pin 4
//   D5 connects to digital pin 5
//   D6 connects to digital pin 6
//   D7 connects to digital pin 7

//Pressure precision
#define MINPRESSURE 2
#define MAXPRESSURE 1000
//300 ohms across the X plate
#define TS_MINX 120
#define TS_MAXX 900
#define TS_MINY 70
#define TS_MAXY 920
TouchScreen ts = TouchScreen(XP, YP, XM, YM, 300);

//16-bit color values:
#define  BLACK   0x0000
#define BLUE    0x001F
#define RED     0xF800
#define GREEN   0x07E0
#define CYAN    0x07FF
#define MAGENTA 0xF81F
#define YELLOW  0xFFE0
#define WHITE   0xFFFF
Elegoo_TFTLCD tft(LCD_CS, LCD_CD, LCD_WR, LCD_RD, LCD_RESET);

//Dino positions
#define run_1 0//run position 1
#define run_2 1//run position 2
#define jump_high 2//jump high
#define jump_half_head 3//jump half upper
#define jump_half_body 4//jump half lower
//Object positions
#define upperObject 5
#define lowerObject 6
#define empty 7
//Initialize variables
//Game starting variables
static bool screenTouched = false;
static bool playing = false;
static bool scoring = false;
static int score = 0;
//Dino Position
static byte currentPos;
static byte currentPosUp;
static byte currentPosDown;
int dino_up_pos = 0;
int dino_low_pos = 0;
//Background (map)
static int upperBG[11] = {7, 7, 7, 7, 7, 7, 7, 7, 7, 7, 7};
static int lowerBG[11] = {7, 7, 7, 7, 7, 7, 7, 7, 7, 7, 7};

//GRAPHICS - BitMaps
// 'Run_1', 32x46px
const unsigned char run1 [] PROGMEM = {
  0x00, 0x00, 0x00, 0x00, 0x00, 0x00, 0x00, 0x00, 0x00, 0x00, 0x00, 0x00, 0x00, 0x00, 0x00, 0x00,
  0x00, 0x00, 0x00, 0x00, 0x00, 0x00, 0x00, 0x00, 0x00, 0x00, 0x00, 0x00, 0x00, 0x00, 0x00, 0x00,
  0x00, 0x00, 0x00, 0x00, 0x00, 0x00, 0x00, 0x00, 0x00, 0x00, 0x00, 0x00, 0x00, 0x00, 0x7f, 0xff,
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  0x00, 0x00, 0x00, 0x00, 0x00, 0x00, 0x00, 0x00
};
//'Run_2', 32x46px
const unsigned char run2 [] PROGMEM = {
  0x00, 0x00, 0x00, 0x00, 0x00, 0x00, 0x00, 0x00, 0x00, 0x00, 0x00, 0x00, 0x00, 0x00, 0x00, 0x00,
  0x00, 0x00, 0x00, 0x00, 0x00, 0x00, 0x00, 0x00, 0x00, 0x00, 0x00, 0x00, 0x00, 0x00, 0x00, 0x00,
  0x00, 0x00, 0x00, 0x00, 0x00, 0x00, 0x00, 0x00, 0x00, 0x00, 0x00, 0x00, 0x00, 0x00, 0x7f, 0xff,
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  0x00, 0x00, 0x00, 0x00, 0x00, 0x00, 0x00, 0x00
};
// 'Dino_Half_Head', 32x46px
const unsigned char halfhead [] PROGMEM = {
  0x00, 0x00, 0x00, 0x00, 0x00, 0x00, 0x00, 0x00, 0x00, 0x00, 0x00, 0x00, 0x00, 0x00, 0x00, 0x00,
  0x00, 0x00, 0x00, 0x00, 0x00, 0x00, 0x00, 0x00, 0x00, 0x00, 0x00, 0x00, 0x00, 0x00, 0x00, 0x00,
  0x00, 0x00, 0x00, 0x00, 0x00, 0x00, 0x00, 0x00, 0x00, 0x00, 0x00, 0x00, 0x00, 0x00, 0x00, 0x00,
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  0x00, 0x07, 0xfc, 0xf8, 0x00, 0x0f, 0xf8, 0x98
};
 // 'Dino_Half_Body', 32x46px
const unsigned char halfbody [] PROGMEM = {
  0x00, 0x0f, 0xff, 0x80, 0x00, 0x0f, 0xff, 0xc0, 0x00, 0x1f, 0xe1, 0xf0, 0x40, 0x3f, 0xc3, 0x30,
  0x60, 0x3f, 0xd9, 0x20, 0x38, 0xff, 0xc0, 0x00, 0x3f, 0xff, 0x86, 0x00, 0x1f, 0xff, 0xf2, 0x00,
  0x0f, 0xff, 0x84, 0x00, 0x07, 0xff, 0x9c, 0x40, 0x03, 0xff, 0xec, 0xe0, 0x01, 0xff, 0x1f, 0xc0,
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  0x00, 0x00, 0x00, 0x00, 0x00, 0x00, 0x00, 0x00
};
// 'Dino_Jump_High', 32x46px
const unsigned char jumphigh [] PROGMEM = {
  0x00, 0x00, 0x00, 0x00, 0x00, 0x00, 0x00, 0x00, 0x00, 0x00, 0x00, 0x00, 0x00, 0x00, 0x00, 0x00,
  0x00, 0x00, 0x00, 0x00, 0x00, 0x00, 0x00, 0x00, 0x00, 0x00, 0x00, 0x00, 0x00, 0x00, 0x00, 0x00,
  0x00, 0x00, 0x00, 0x00, 0x00, 0x00, 0x00, 0x00, 0x00, 0x00, 0x00, 0x00, 0x00, 0x00, 0x00, 0x00,
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  0x00, 0x38, 0x00, 0x00, 0x00, 0x00, 0x00, 0x00
};
 // 'upperObject', 32x46px
const unsigned char top1 [] PROGMEM = {
  0x00, 0x00, 0x00, 0x00, 0x00, 0x00, 0x00, 0x00, 0x00, 0x00, 0x00, 0x00, 0x00, 0x00, 0x00, 0x00,
  0x00, 0x00, 0x00, 0x00, 0x00, 0x00, 0x00, 0x00, 0x00, 0x00, 0x00, 0x00, 0x00, 0x00, 0x00, 0x00,
  0x00, 0x00, 0x00, 0x00, 0x00, 0x00, 0x00, 0x00, 0x00, 0x00, 0x00, 0x00, 0x00, 0x00, 0x00, 0x00,
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  0x00, 0x00, 0x00, 0x00, 0x00, 0x00, 0x00, 0x00
};
// 'lowerObject', 32x46px
const unsigned char bot1 [] PROGMEM = {
  0x00, 0x00, 0x00, 0x00, 0x00, 0x00, 0x00, 0x00, 0x00, 0x00, 0x00, 0x00, 0x00, 0x00, 0x00, 0x00,
  0x00, 0x00, 0x00, 0x00, 0x00, 0x00, 0x00, 0x00, 0x00, 0x00, 0x00, 0x00, 0x00, 0x00, 0x00, 0x00,
  0x00, 0x00, 0x00, 0x00, 0x00, 0x00, 0x00, 0x00, 0x00, 0x00, 0x00, 0x00, 0x00, 0x00, 0x00, 0x00,
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  0x00, 0x03, 0xe0, 0x00, 0x00, 0x03, 0xe0, 0x00
};
// 'Empty', 32x46px
const unsigned char empt [] PROGMEM = {
  0x00, 0x00, 0x00, 0x00, 0x00, 0x00, 0x00, 0x00, 0x00, 0x00, 0x00, 0x00, 0x00, 0x00, 0x00, 0x00,
  0x00, 0x00, 0x00, 0x00, 0x00, 0x00, 0x00, 0x00, 0x00, 0x00, 0x00, 0x00, 0x00, 0x00, 0x00, 0x00,
  0x00, 0x00, 0x00, 0x00, 0x00, 0x00, 0x00, 0x00, 0x00, 0x00, 0x00, 0x00, 0x00, 0x00, 0x00, 0x00,
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  0x00, 0x00, 0x00, 0x00, 0x00, 0x00, 0x00, 0x00
};
//'Starting screen', 320x240px
const unsigned char start [] PROGMEM = {
  0xff, 0xff, 0xff, 0xff, 0xff, 0xff, 0xff, 0xff, 0xff, 0xff, 0xff, 0xff, 0xff, 0xff, 0xff, 0xff,
  0xff, 0xff, 0xff, 0xff, 0xff, 0xff, 0xff, 0xff, 0xff, 0xff, 0xff, 0xff, 0xff, 0xff, 0xff, 0xff,
  0xff, 0xff, 0xff, 0xff, 0xff, 0xff, 0xff, 0xff, 0xff, 0xff, 0xff, 0xff, 0xff, 0xff, 0xff, 0xff,
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  0xff, 0xff, 0xff, 0xff, 0xff, 0xff, 0xff, 0xff, 0xff, 0xff, 0xff, 0xff, 0xff, 0xff, 0xff, 0xff
};
// 'Ground', 320x5px
const unsigned char ground [] PROGMEM = {
  0xff, 0xff, 0xff, 0xff, 0x80, 0x00, 0x00, 0x00, 0x00, 0x00, 0x00, 0x00, 0x00, 0x00, 0x00, 0x00,
  0x00, 0x00, 0x00, 0x00, 0x00, 0x00, 0x00, 0x00, 0x00, 0x00, 0x00, 0x00, 0x00, 0x00, 0x00, 0x00,
  0x00, 0x00, 0x00, 0x01, 0xff, 0xff, 0xff, 0xff, 0xff, 0xff, 0xff, 0xff, 0x80, 0x00, 0x00, 0x00,
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  0x00, 0x00, 0x00, 0x01, 0xff, 0xff, 0xff, 0xff
};


//BitMap graphics for Dino Positions
void drawDinoWalk() {
  dino_low_pos = 1;
  tft.fillRect(0, 120, 32, 46, BLACK);
  tft.drawBitmap(0, 120, run2, 32, 46, WHITE);
  //delay(50);
  tft.fillRect(0, 120, 32, 46, BLACK);
  tft.drawBitmap(0, 120, run1, 32, 46, WHITE);
  //delay(50);
  detect();
}

void drawDinoJump() {
  //half up + down
  dino_low_pos = 1;
  dino_up_pos = 1;
  tft.setCursor (0, 0);
  tft.fillRect(0, 120, 32, 46, BLACK);
  tft.fillRect(0, 74, 32, 46, BLACK);
  tft.drawBitmap(0, 74, halfhead, 32, 46, WHITE);
  tft.drawBitmap(0, 120, halfbody, 32, 46, WHITE);
  detect();
  delay(100);
  drawObject();
  //up
  dino_low_pos = 0;
  dino_up_pos = 1;
  tft.fillRect(0, 120, 32, 46, BLACK);
  tft.fillRect(0, 74, 32, 46, BLACK);
  tft.drawBitmap(0, 74, jumphigh, 32, 46, WHITE);
  detect();
  delay(100);
  drawObject();
  detect();
  delay(100);
  drawObject();
  detect();
  //down
  dino_low_pos = 1;
  dino_up_pos = 1;
  tft.fillRect(0, 74, 32, 46, BLACK);
  tft.fillRect(0, 120, 32, 46, BLACK);
  tft.drawBitmap(0, 74, halfhead, 32, 46, WHITE);
  tft.drawBitmap(0, 120, halfbody, 32, 46, WHITE);
  delay(100);
  tft.fillRect(0, 74, 32, 46, BLACK);
  dino_up_pos = 0;
  dino_low_pos = 1;
  detect();
}

//Generates objects at random
void objectRandom (int upperBG[], int lowerBG[]) {
  int ObjectPos = random(5, 10);
  Serial.println(ObjectPos);
  //Object Array
  switch (ObjectPos) {
    case upperObject:
      lowerBG[10] = empty;
      //upper and lower too close
      if ((lowerBG[9] == lowerObject) || (lowerBG[8] == lowerObject)) upperBG[10] = empty;
      else upperBG[10] = upperObject;
      break;
    case lowerObject:
      //Max two lower objects in a row or upper and lower too close
      if ((lowerBG[9] == lowerObject) || (lowerBG[8] == lowerObject) || (lowerBG[7] == lowerObject) || (upperBG[9] == upperObject) || (upperBG[8] == upperObject)) {
        lowerBG[10] = empty;
      }
      else lowerBG[10] = lowerObject;
      break;
    case empty:
    case 8: //empty2
    case 9: //empty3
    case 10: //empty4
      upperBG[10] = empty;
      lowerBG[10] = empty;
      break;
  }
}

//BitMap object generator 
unsigned char *objects(int n, const unsigned char top1 [] PROGMEM, const unsigned char bot1 [] PROGMEM, const unsigned char empt [] PROGMEM) {
  switch (n) {
    case 5:
      return top1;
    case 6:
      return bot1;
    case 7:
      return empt;
  }
}

//Draws object on map
void drawObject () {
  objectRandom(upperBG, lowerBG);
  for (int i = 0; i < 10; i++) {
    upperBG[i] = upperBG[i + 1];
    lowerBG[i] = lowerBG[i + 1];
  }
  if (upperBG[0] != 7) {
    tft.drawBitmap(0, 74, top1, 32, 46, WHITE);
  }
  else if (dino_up_pos == 0) {
    tft.fillRect(0, 74, 32, 46, BLACK);
  }
  if (lowerBG[0] != 7) {
    tft.drawBitmap(0, 120, bot1, 32, 46, WHITE);
  }
  else if (dino_low_pos == 0) {
    tft.fillRect(0, 120, 32, 46, BLACK);
  }
  for (int i = 1; i < 10; i++) {
    tft.fillRect(32 * i, 74, 32, 46, BLACK);
    tft.drawBitmap(32 * i, 74, objects(upperBG[i], top1, bot1, empt), 32, 46, WHITE);
    tft.fillRect(32 * i, 120, 32, 46, BLACK);
    tft.drawBitmap(32 * i, 120, objects(lowerBG[i], top1, bot1, empt), 32, 46, WHITE);
  }
}


//Collision with Object Detection
void detect() {
  if ((dino_up_pos == 1 && upperBG[0] != 7) || (dino_low_pos == 1 && lowerBG[0] != 7)) {
    tft.fillScreen(BLACK);
    playing = false;
    scoring = false;
  }
}


//Game Over Screen (when character collides with object)
void over() {
  tft.fillScreen(BLACK);
  tft.setCursor (50, 80);
  tft.setTextSize(4);
  tft.println ("GAME OVER");
  tft.setCursor (60, 140);
  tft.setTextSize(3);
  tft.println ("Score: ");
  tft.setCursor (210, 140);
  tft.println (score);
  delay(100000000000000000);
}


//Start game (When user touches screen)
void waitOneTouch(void) {
  TSPoint p;
  do {
    p = ts.getPoint();
    pinMode(XM, OUTPUT);
    pinMode(YP, OUTPUT);
  } while ((p.z < MINPRESSURE ) || (p.z > MAXPRESSURE));
  if (p.z > MINPRESSURE && p.z < MAXPRESSURE) {
    Serial.println(F("ScreenTouch detect, start"));
    playing = true;
    scoring = true;
    tft.fillScreen(BLACK);
    tft.fillRect(0, 166, 320, 5, WHITE);
  }
}

//Setup 
void setup(void) {
  Serial.begin(9600);
  Serial.println(F("TFT LCD test"));
#ifdef USE_Elegoo_SHIELD_PINOUT
  Serial.println(F("Using Elegoo 2.4\" TFT Arduino Shield Pinout"));
#else
  Serial.println(F("Using Elegoo 2.4\" TFT Breakout Board Pinout"));
#endif
  Serial.print("TFT size is "); Serial.print(tft.width()); Serial.print("x"); Serial.println(tft.height());
  tft.reset();
  uint16_t identifier = tft.readID();
  if (identifier == 0x9325) {
    Serial.println(F("Found ILI9325 LCD driver"));
  } else if (identifier == 0x9328) {
    Serial.println(F("Found ILI9328 LCD driver"));
  } else if (identifier == 0x4535) {
    Serial.println(F("Found LGDP4535 LCD driver"));
  } else if (identifier == 0x7575) {
    Serial.println(F("Found HX8347G LCD driver"));
  } else if (identifier == 0x9341) {
    Serial.println(F("Found ILI9341 LCD driver"));
  } else if (identifier == 0x8357) {
    Serial.println(F("Found HX8357D LCD driver"));
  } else if (identifier == 0x0101)
  {
    identifier = 0x9341;
    Serial.println(F("Found 0x9341 LCD driver"));
  }
  else if (identifier == 0x1111)
  {
    identifier = 0x9328;
    Serial.println(F("Found 0x9328 LCD driver"));
  }
  else {
    Serial.print(F("Unknown LCD driver chip: "));
    Serial.println(identifier, HEX);
    Serial.println(F("If using the Elegoo 2.8\" TFT Arduino shield, the line:"));
    Serial.println(F("  #define USE_Elegoo_SHIELD_PINOUT"));
    Serial.println(F("should appear in the library header (Elegoo_TFT.h)."));
    Serial.println(F("If using the breakout board, it should NOT be #defined!"));
    Serial.println(F("Also if using the breakout, double-check that all wiring"));
    Serial.println(F("matches the tutorial."));
    identifier = 0x9328;
  }
  randomSeed(analogRead(A5));
  tft.begin(identifier);
  tft.setRotation(1);
  tft.drawBitmap(0, 0, start, 320, 240, WHITE);
}


//Touchscreen dectection
bool touching (void) {
  for (int i = 0; i < 30; i++) {
    TSPoint p = ts.getPoint();
    pinMode(XM, OUTPUT);
    pinMode(YP, OUTPUT);
    if (p.z > MINPRESSURE /*&& p.z < MAXPRESSURE*/) {
      Serial.println(F("ScreenTouch detect"));
      screenTouched = true;
      return screenTouched;
    }
    else if (p.z == 0) {
      Serial.println(F(" No ScreenTouch detect"));
    }
  }
  return screenTouched;
}


//Game Loop
void loop(void) {
  Serial.println(F("running"));
  //Not playing
  if (!playing) {
    if (score == 0) {
      waitOneTouch();
    }
    else {
      over();
    }
  }
  //Playing
  else {
    tft.setCursor(20, 30);
    tft.setTextSize(3);
    tft.println("score ");
    tft.setCursor(120, 30);
    tft.setTextSize(3);
    tft.println(score);
    drawDinoWalk();
    drawObject();
    //Dino jumping (when touch)
    if (touching()) {
      drawDinoJump();
      screenTouched = false;
    }
    tft.fillRect(0, 0, 180, 50, BLACK);
  }
  //Score increases while playing
  if (scoring == true) {
    score++;
  }

}
