// IMPORTANT: ELEGOO_TFTLCD LIBRARY MUST BE SPECIFICALLY
// CONFIGURED FOR EITHER THE TFT SHIELD OR THE BREAKOUT BOARD.
// SEE RELEVANT COMMENTS IN Elegoo_TFTLCD.h FOR SETUP.
//Technical support:goodtft@163.com

#include <Elegoo_GFX.h>    // Core graphics library
#include <Elegoo_TFTLCD.h> // Hardware-specific library
#include <TouchScreen.h>
#include <stdint.h>

// The control pins for the LCD can be assigned to any digital or
// analog pins...but we'll use the analog pins as this allows us to
// double up the pins with the touch screen (see the TFT paint example).
#define LCD_CS A3 // Chip Select goes to Analog 3
#define LCD_CD A2 // Command/Data goes to Analog 2
#define LCD_WR A1 // LCD Write goes to Analog 1
#define LCD_RD A0 // LCD Read goes to Analog 0
#define YP A3  // must be an analog pin, use "An" notation!
#define XM A2  // must be an analog pin, use "An" notation!
#define YM 9   // can be a digital pin
#define XP 8   // can be a digital pin
#define LCD_RESET A4 // Can alternately just connect to Arduino's reset pin

// When using the BREAKOUT BOARD only, use these 8 data lines to the LCD:
// For the Arduino Uno, Duemilanove, Diecimila, etc.:
//   D0 connects to digital pin 8  (Notice these are
//   D1 connects to digital pin 9   NOT in order!)
//   D2 connects to digital pin 2
//   D3 connects to digital pin 3
//   D4 connects to digital pin 4
//   D5 connects to digital pin 5
//   D6 connects to digital pin 6
//   D7 connects to digital pin 7
// For the Arduino Mega, use digital pins 22 through 29
// (on the 2-row header at the end of the board).

#define MINPRESSURE 10
#define MAXPRESSURE 1000

// For better pressure precision, we need to know the resistance
// between X+ and X- Use any multimeter to read it
// For the one we're using, its 300 ohms across the X plate
TouchScreen ts = TouchScreen(XP, YP, XM, YM, 300);
TSPoint p = ts.getPoint();
// Assign human-readable names to some common 16-bit color values:
#define  BLACK   0x0000
#define BLUE    0x001F
#define RED     0xF800
#define GREEN   0x07E0
#define CYAN    0x07FF
#define MAGENTA 0xF81F
#define YELLOW  0xFFE0
#define WHITE   0xFFFF

Elegoo_TFTLCD tft(LCD_CS, LCD_CD, LCD_WR, LCD_RD, LCD_RESET);
// If using the shield, all control and data lines are fixed, and
// a simpler declaration can optionally be used:
// Elegoo_TFTLCD tft;

//Dino positions
#define run_1 0//run position 1
#define run_2 1//run position 2
#define jump_high 2//jump high
#define jump_half_head 3//jump half upper
#define jump_half_body 4//jump half lower

#define upperObject 5
#define lowerObject 6
#define empty 7

int dino_up_pos=0;
int dino_low_pos=0;

static bool screenTouched = false;
static byte currentPos;
static byte currentPosUp;
static byte currentPosDown;
static int score = 0;
static bool playing = true;
static bool scoring =false;
static int upperBG[11] = {7,7,7,7,7,7,7,7,7,7,7};
static int lowerBG[11] = {7,7,7,7,7,7,7,7,7,7,7};


// 'Dino_Run_1', 20x28px

const unsigned char run1 [] PROGMEM = {
// 'Dino_Run_1', 32x46px
  0x00, 0x00, 0x00, 0x00, 0x00, 0x00, 0x00, 0x00, 0x00, 0x00, 0x00, 0x00, 0x00, 0x00, 0x00, 0x00, 
  0x00, 0x00, 0x00, 0x00, 0x00, 0x00, 0x00, 0x00, 0x00, 0x00, 0x00, 0x00, 0x00, 0x00, 0x00, 0x00, 
  0x00, 0x00, 0x00, 0x00, 0x00, 0x00, 0x00, 0x00, 0x00, 0x00, 0x00, 0x00, 0x00, 0x00, 0x7f, 0xff, 
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  0x00, 0x00, 0x00, 0x00, 0x00, 0x00, 0x00, 0x00
};


const unsigned char run2 [] PROGMEM = {
// 'Dino_Run_2', 32x46px
  0x00, 0x00, 0x00, 0x00, 0x00, 0x00, 0x00, 0x00, 0x00, 0x00, 0x00, 0x00, 0x00, 0x00, 0x00, 0x00, 
  0x00, 0x00, 0x00, 0x00, 0x00, 0x00, 0x00, 0x00, 0x00, 0x00, 0x00, 0x00, 0x00, 0x00, 0x00, 0x00, 
  0x00, 0x00, 0x00, 0x00, 0x00, 0x00, 0x00, 0x00, 0x00, 0x00, 0x00, 0x00, 0x00, 0x00, 0x7f, 0xff, 
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  0x00, 0x00, 0x00, 0x00, 0x00, 0x00, 0x00, 0x00
};

const unsigned char halfhead [] PROGMEM = {
// 'Dino_Jump_Head', 32x46px
  0x00, 0x00, 0x00, 0x00, 0x00, 0x00, 0x00, 0x00, 0x00, 0x00, 0x00, 0x00, 0x00, 0x00, 0x00, 0x00, 
  0x00, 0x00, 0x00, 0x00, 0x00, 0x00, 0x00, 0x00, 0x00, 0x00, 0x00, 0x00, 0x00, 0x00, 0x00, 0x00, 
  0x00, 0x00, 0x00, 0x00, 0x00, 0x00, 0x00, 0x00, 0x00, 0x00, 0x00, 0x00, 0x00, 0x00, 0x00, 0x00, 
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  0x00, 0x07, 0xfc, 0xf8, 0x00, 0x0f, 0xf8, 0x98
};

const unsigned char halfbody [] PROGMEM = {
// 'Dino_Jump_Body', 32x46px
0x00, 0x0f, 0xff, 0x80, 0x00, 0x0f, 0xff, 0xc0, 0x00, 0x1f, 0xe1, 0xf0, 0x40, 0x3f, 0xc3, 0x30,
0x60, 0x3f, 0xd9, 0x20, 0x38, 0xff, 0xc0, 0x00, 0x3f, 0xff, 0x86, 0x00, 0x1f, 0xff, 0xf2, 0x00,
0x0f, 0xff, 0x84, 0x00, 0x07, 0xff, 0x9c, 0x40, 0x03, 0xff, 0xec, 0xe0, 0x01, 0xff, 0x1f, 0xc0,
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0x00, 0x00, 0x00, 0x00, 0x00, 0x00, 0x00, 0x00
};

const unsigned char jumphigh [] PROGMEM = {
// 'Dino_Jump_High', 32x46px
  0x00, 0x00, 0x00, 0x00, 0x00, 0x00, 0x00, 0x00, 0x00, 0x00, 0x00, 0x00, 0x00, 0x00, 0x00, 0x00, 
  0x00, 0x00, 0x00, 0x00, 0x00, 0x00, 0x00, 0x00, 0x00, 0x00, 0x00, 0x00, 0x00, 0x00, 0x00, 0x00, 
  0x00, 0x00, 0x00, 0x00, 0x00, 0x00, 0x00, 0x00, 0x00, 0x00, 0x00, 0x00, 0x00, 0x00, 0x00, 0x00, 
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  0x00, 0x38, 0x00, 0x00, 0x00, 0x00, 0x00, 0x00
};

const unsigned char empt [] PROGMEM = {
// 'Empty', 32x46px
  0xff, 0xff, 0xff, 0xff, 0xff, 0xff, 0xff, 0xff, 0xff, 0xff, 0xff, 0xff, 0xff, 0xff, 0xff, 0xff, 
  0xff, 0xff, 0xff, 0xff, 0xff, 0xff, 0xff, 0xff, 0xff, 0xff, 0xff, 0xff, 0xff, 0xff, 0xff, 0xff, 
  0xff, 0xff, 0xff, 0xff, 0xff, 0xff, 0xff, 0xff, 0xff, 0xff, 0xff, 0xff, 0xff, 0xff, 0xff, 0xff, 
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  0xff, 0xff, 0xff, 0xff, 0xff, 0xff, 0xff, 0xff

};

const unsigned char top1 [] PROGMEM = {
// 'Bird', 32x46px
0x00, 0x00, 0x00, 0x00, 0x00, 0x00, 0x00, 0x00, 0x00, 0x00, 0x00, 0x00, 0x00, 0x00, 0x00, 0x00,
0x00, 0x00, 0x00, 0x00, 0x00, 0x00, 0x00, 0x00, 0x00, 0x00, 0x00, 0x00, 0x00, 0x00, 0x00, 0x00,
0x00, 0x00, 0x00, 0x00, 0x00, 0x00, 0x00, 0x00, 0x00, 0x00, 0x00, 0x00, 0x00, 0x00, 0x00, 0x00,
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0x00, 0x00, 0x00, 0x00, 0x00, 0x00, 0x00, 0x00

};

const unsigned char bot1 [] PROGMEM = {
// 'Cactus', 32x46px
  0x00, 0x00, 0x00, 0x00, 0x00, 0x00, 0x00, 0x00, 0x00, 0x00, 0x00, 0x00, 0x00, 0x00, 0x00, 0x00, 
  0x00, 0x00, 0x00, 0x00, 0x00, 0x00, 0x00, 0x00, 0x00, 0x00, 0x00, 0x00, 0x00, 0x00, 0x00, 0x00, 
  0x00, 0x00, 0x00, 0x00, 0x00, 0x00, 0x00, 0x00, 0x00, 0x00, 0x00, 0x00, 0x00, 0x00, 0x00, 0x00, 
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  0x00, 0x03, 0xe0, 0x00, 0x00, 0x03, 0xe0, 0x00

};


unsigned char objects(int n){
  switch(n){
  case 5:
    return top1;
  case 6:
    return bot1;
  case 7:
    return empt;
  }
}

void drawDino0(){
  //Starting screen
  tft.setCursor (0,0);
  tft.println("Press to Start!");
  tft.drawBitmap(0, 120, run1 ,32, 46,WHITE);
  /*tft.drawBitmap(32, 120, run2 ,32, 46,WHITE);
  tft.drawBitmap(64, 74, halfhead ,32, 46,WHITE);
  tft.drawBitmap(64, 120, halfbody,32, 46,WHITE);
  tft.drawBitmap(96, 74, jumphigh ,32, 46,WHITE);
  tft.drawBitmap(128, 74, top1 ,32, 46,WHITE);
  tft.drawBitmap(160, 120, bot1 ,32, 46,WHITE);
  tft.drawBitmap(192, 120, empt ,32, 46,YELLOW);*/
}
void drawDinoWalk(){
  dino_low_pos=1;
  tft.fillRect(0, 120, 32, 46, BLACK);
  tft.drawBitmap(0, 120, run2,32, 46, WHITE);
  delay(50);
  tft.fillRect(0, 120, 32, 46, BLACK);
  tft.drawBitmap(0, 120, run1,32, 46, WHITE);
  delay(50);
  
  detect();
}
void drawDinoJump(){
  //half up + down
  dino_low_pos=1;
  dino_up_pos=1;
  tft.setCursor (0,0);
  tft.drawBitmap(0, 74, halfhead,32, 46, RED);
  tft.drawBitmap(0, 120, halfbody,32, 46, RED);
  detect();
  
  delay(200);
  drawObject();
  //up
  dino_low_pos=0;
  dino_up_pos=1;
  tft.drawBitmap(0, 74, jumphigh,32, 46, RED);
  tft.drawBitmap(0, 120, empt,32, 46, YELLOW);
  detect();
  
  
  delay(200);
  drawObject();
  detect();
  delay(200);
  drawObject();
  detect();
  
  //down
  dino_low_pos=1;
  dino_up_pos=1;

  tft.drawBitmap(0, 74, halfhead,32, 46, RED);
  tft.drawBitmap(0, 120, halfbody,32, 46, RED);
  delay(200);
  tft.drawBitmap(0,74, empt,32, 46, YELLOW);
  dino_up_pos=0;
  dino_low_pos=1;
  detect();
}
void objectRandom (int upperBG[], int lowerBG[]){
  int ObjectPos = random(5,10);
  //Object Array
  switch (ObjectPos){
  case upperObject:
    lowerBG[10] = empty;
    //upper and lower too close
    if (lowerBG[10] == lowerObject) upperBG[10] = empty;
    else upperBG[10] = upperObject;    
   break;
  case lowerObject:
    //Max two lower objects in a row or upper and lower too close
    if ((lowerBG[9] == lowerObject)||(lowerBG[8] == lowerObject)|| (lowerBG[7] == lowerObject)||(upperBG[9] == upperObject)||(upperBG[8]==upperObject)){
      lowerBG[10] = empty;
    }
    else lowerBG[10] = lowerObject;
   break;
  case empty:
  case 8: //empty2
  case 9: //empty3
  case 10: //empty4
    upperBG[10] = empty;
    lowerBG[10] = empty;
   break;
  }
}


void detect(){
  if((dino_up_pos==1&&upperBG[0]!=7)||(dino_low_pos==1&&lowerBG[0]!=7)){
    tft.fillScreen(BLACK);
    playing = false;
    scoring = false;
  }
}

void drawObject (){
  
  objectRandom(upperBG,lowerBG);
  
  for (int i = 0; i < 10; i++){
    upperBG[i]=upperBG[i+1];
    lowerBG[i]=lowerBG[i+1];
  }
  if(upperBG[0]!=7){
      tft.drawBitmap(0, 74, top1, 32, 46, RED);
  }
  else if(dino_up_pos==0){
      tft.fillRect(0, 74, 32, 46, BLACK);
  }


  if(lowerBG[0]!=7){
      tft.drawBitmap(0, 120, bot1, 32, 46, RED);
  }
  else if(dino_low_pos==0){
      tft.fillRect(0, 120, 32, 46, BLACK);
  }
  for (int i = 1; i < 10; i++){
      tft.fillRect(0,0,64,10,BLACK);
      tft.setCursor(0,0);
      tft.println(upperBG[i]);
      tft.setCursor(32,0);
      tft.println(lowerBG[i]);
      
      tft.fillRect(32*i,74,32,46,BLACK);
      tft.drawBitmap(32*i, 74, objects(upperBG[i]), 32, 46, RED);
      tft.fillRect(32*i,120,32,46,BLACK);
      tft.drawBitmap(32*i, 120, objects(lowerBG[i]), 32, 46, RED);
      delay(2000);
  }

}

void over(){
   tft.fillScreen(BLACK);
   tft.setCursor (0,0);
   tft.println ("Game Over!");
   tft.setCursor (0,8);
   tft.println ("Score:");
   tft.setCursor (20,8);
   tft.println (score);
   delay(100000000000000000);
}


void setup(void) {

  Serial.begin(9600);
  Serial.println(F("TFT LCD test"));

#ifdef USE_Elegoo_SHIELD_PINOUT
  Serial.println(F("Using Elegoo 2.4\" TFT Arduino Shield Pinout"));
#else
  Serial.println(F("Using Elegoo 2.4\" TFT Breakout Board Pinout"));
#endif

  Serial.print("TFT size is "); Serial.print(tft.width()); Serial.print("x"); Serial.println(tft.height());

  tft.reset();

   uint16_t identifier = tft.readID();
   if(identifier == 0x9325) {
    Serial.println(F("Found ILI9325 LCD driver"));
  } else if(identifier == 0x9328) {
    Serial.println(F("Found ILI9328 LCD driver"));
  } else if(identifier == 0x4535) {
    Serial.println(F("Found LGDP4535 LCD driver"));
  }else if(identifier == 0x7575) {
    Serial.println(F("Found HX8347G LCD driver"));
  } else if(identifier == 0x9341) {
    Serial.println(F("Found ILI9341 LCD driver"));
  } else if(identifier == 0x8357) {
    Serial.println(F("Found HX8357D LCD driver"));
  } else if(identifier==0x0101)
  {     
      identifier=0x9341;
       Serial.println(F("Found 0x9341 LCD driver"));
  }
  else if(identifier==0x1111)
  {     
      identifier=0x9328;
       Serial.println(F("Found 0x9328 LCD driver"));
  }
  else {
    Serial.print(F("Unknown LCD driver chip: "));
    Serial.println(identifier, HEX);
    Serial.println(F("If using the Elegoo 2.8\" TFT Arduino shield, the line:"));
    Serial.println(F("  #define USE_Elegoo_SHIELD_PINOUT"));
    Serial.println(F("should appear in the library header (Elegoo_TFT.h)."));
    Serial.println(F("If using the breakout board, it should NOT be #defined!"));
    Serial.println(F("Also if using the breakout, double-check that all wiring"));
    Serial.println(F("matches the tutorial."));
    identifier=0x9328;
  
  }
  tft.begin(identifier);
 tft.setRotation(1);
 tft.fillScreen(BLACK);
}

bool touching(void){
   if (p.z > MINPRESSURE && p.z < MAXPRESSURE) {
    screenTouched = true;
   }
}

void loop(void) {
  //unsigned long start = micros();
  //tft.setCursor(0, 0);
  //detect();

  if (!playing) {
    if(score==0){
      drawDino0();
    }
    else{
      over();
    }
  }
  else {
    drawDinoWalk();
    drawObject();
    if(touching()){
      drawDinoJump();
      screenTouched = false;
    }
  }
  
  if (touching()) {
    playing = true;
    scoring = true;
    tft.fillScreen(BLACK);
    screenTouched = false;
  }
  if (scoring == true){
    score++;
  }
  //Generate object
  
    return;
}
